## Kconfig
```kconfig
config ZMK_INPUT_PROCESSOR_THRESHOLD
    bool "Pointing device threshold block"
    depends on ZMK_POINTING

config ZMK_INPUT_PROCESSOR_THRESHOLD_BLOCK_BUTTONS
    bool "Block button events while threshold is not met"
    depends on ZMK_INPUT_PROCESSOR_THRESHOLD
    default y

config ZMK_INPUT_PROCESSOR_THRESHOLD_BLOCK_SCROLL
    bool "Block scroll events while threshold is not met"
    depends on ZMK_INPUT_PROCESSOR_THRESHOLD
    default y
```

## dts/bindings/input/zmk,input-processor-movement-threshold.yaml
```yaml
description: |
  Accumulates input movement from a standing start and blocks all events
  until the total magnitude crosses a threshold. Resets after a configurable
  idle period with no input.

  Example:
    &movement_threshold 10 200

  param1: threshold — minimum total movement (sum of |dx| + |dy|) in raw
          sensor counts required before events are passed through.
  param2: idle-ms — milliseconds of no input after which the accumulator
          resets and the next movement starts gated again.

compatible: "zmk,input-processor-movement-threshold"

include: ip_two_param.yaml
```
